## board/tellabs/tlabp204x/Kconfig
```kconfig
if TARGET_TLABP204X

config SYS_BOARD
	default "tlabp204x"

config SYS_VENDOR
	default "tellabs"

config SYS_CONFIG_NAME
	default "TLABP204X"

endif
```

## configs/TLABP204X_defconfig
```kconfig
CONFIG_PPC=y
CONFIG_MPC85xx=y
CONFIG_TARGET_TLABP204X=y
CONFIG_NETDEVICES=y
CONFIG_SYS_NS16550=y

CONFIG_SYS_DTSEC_AUTONEG_DISABLE=y
CONFIG_TLABP204X=y
CONFIG_TSEC_TBIANA_SETTINGS=y

CONFIG_HUSH_PARSER=y

#CONFIG_NET_RANDOM_ETHADDR=y
CONFIG_HAS_ETH1 =y
CONFIG_HAS_ETH2 =y

#CONFIG_TLAB_MV88E6097_SWITCH=y

CONFIG_FIT=y
CONFIG_FIT_VERBOSE=y
CONFIG_OF_BOARD_SETUP=y
CONFIG_OF_STDOUT_VIA_ALIAS=y
CONFIG_OF_LIBFDT=y
CONFIG_E1000=y
```
